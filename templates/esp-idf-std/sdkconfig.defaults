## templates/esp-idf-std/sdkconfig.defaults
```kconfig
# ESP-IDF SDK Configuration Defaults
# Generated by ESP Forge for ESP32-S3
# These settings are used by the esp-idf-sys build crate when building ESP-IDF.

# Flash settings
CONFIG_ESPTOOLPY_FLASHSIZE_4MB=y
CONFIG_ESPTOOLPY_FLASHMODE_QIO=y
CONFIG_ESPTOOLPY_FLASHFREQ_80M=y

# Partition table
CONFIG_PARTITION_TABLE_SINGLE_APP=y

# FreeRTOS settings for Rust
CONFIG_FREERTOS_HZ=1000
CONFIG_FREERTOS_UNICORE=n

# Enable UART console
CONFIG_ESP_CONSOLE_UART_DEFAULT=y
CONFIG_ESP_CONSOLE_UART_BAUDRATE=115200

# Stack size for main task
CONFIG_ESP_MAIN_TASK_STACK_SIZE=8192

# Disable Bluetooth by default (enable in features if needed)
# CONFIG_BT_ENABLED=n

# Log level
CONFIG_LOG_DEFAULT_LEVEL_INFO=y
```
